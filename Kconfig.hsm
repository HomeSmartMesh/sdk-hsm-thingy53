## Kconfig.hsm
```kconfig
menu "Home Smart Mesh"

rsource "samples/Kconfig"
rsource "subsys/Kconfig"

endmenu
```

## drivers/sensor/Kconfig
```kconfig
menuconfig SENSOR
	bool "Sensor Drivers"
	help
		Include sensor drivers in config

if SENSOR

rsource "bme688/Kconfig"
rsource "bh1749/Kconfig"

endif # SENSOR
```

## drivers/sensor/bh1749/Kconfig
```kconfig
#
#  Copyright (c) 2019 Nordic Semiconductor ASA
#
#  SPDX-License-Identifier: LicenseRef-Nordic-5-Clause
#

menuconfig BH1749_ADAPTIVE
	bool "Adaptive BH1749 Sensor"
	depends on I2C
	help
	  Enable driver for Adaptive BH1749 sensors.
```

## drivers/sensor/bme688/Kconfig
```kconfig
# BME688 temperature, humidity pressure and gas configuration options

config BME688
	bool "BME688 sensor"
	depends on I2C
	help
	  Enable driver for BME688 I2C based temperature, pressure, humidity and gas sensor.
```

## samples/12_ot_udp/sample.yaml
```yaml
sample:
  name: OpenThread CLI sample
  description: Test OpenThread Command Line Interface on Thingy53
```

## samples/Kconfig
```kconfig
config HSM_SAMPLES_DEFAULTS
	bool "Enable HSM sample default settings"
	default n
	help
	  Use the default configuration for HSM samples.
```

## subsys/Kconfig
```kconfig
#
# Copyright (c) 2018 - 2020 Nordic Semiconductor
#
# SPDX-License-Identifier: LicenseRef-Nordic-5-Clause
#

rsource "app_battery/Kconfig"
rsource "app_led/Kconfig"
rsource "app_ot/Kconfig"
rsource "json_endpoint/Kconfig"
rsource "udp_broadcast/Kconfig"
rsource "bme688_server/Kconfig"
rsource "app_flash/Kconfig"
```

## subsys/app_battery/Kconfig
```kconfig
menuconfig APP_BATTERY
	bool "Application battery sensor API"
	default n
	depends on GPIO
	depends on PWM
	depends on ADC
	help
	  Enable Application battery sensor API.
```

## subsys/bme688_server/Kconfig
```kconfig
menuconfig BME688_SERVER
	bool "BME688 server"
	default n
	depends on CPLUSPLUS
	depends on EXCEPTIONS
	help
	  Enable a thread to collect bme688 gas samples.

rsource "bsec2/Kconfig"
```

## subsys/bme688_server/bsec2/Kconfig
```kconfig
menuconfig BME688_BSEC2
	bool "BME688 BSEC2 Library"
	default n
	depends on CPLUSPLUS
	depends on EXCEPTIONS
	help
	  Enable Bosch-BSEC2-Library support
```

## subsys/json_endpoint/Kconfig
```kconfig
menuconfig JSON_ENDPOINT
	bool "JSON udp API endpoint"
	default n
	depends on CPLUSPLUS
	depends on EXCEPTIONS
	help
	  Enable handler for receiving JSON and sending response back.
```

## subsys/udp_broadcast/Kconfig
```kconfig
menuconfig UDP_BROADCAST
	bool "UDP send in braodcast config"
	default n
	depends on NET_SOCKETS
	help
	  Enable Application to broadcast UDP packets
```

## west.yml
```yaml
manifest:
  version: 1.0
  remotes:
    # Home Smart Mesh GitHub organization.
    - name: hsm
      url-base: https://github.com/HomeSmartMesh
    - name: zephyrproject
      url-base: https://github.com/zephyrproject-rtos

  defaults:
    remote: hsm

  projects:
    - name: zephyr
      repo-path: zephyr
      remote: zephyrproject
      revision: fcaa60a99fa9d5256078ed28557856ec3709cfa9
      import:
        name-whitelist:
          - cmsis
          - edtt
          - fatfs
          - hal_nordic
          - libmetal
          - littlefs
          - lvgl
          - mbedtls
          - mcuboot
          - mipi-sys-t
          - net-tools
          - nrf_hw_models
          - openthread
          - segger
          - tinycrypt

  self:
    path: hsm
```
