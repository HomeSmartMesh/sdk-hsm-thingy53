## CMakeLists.txt
```
#
# Copyright (c) 2020 Nordic Semiconductor ASA
#
# SPDX-License-Identifier: LicenseRef-Nordic-5-Clause
#
cmake_minimum_required(VERSION 3.20.0)

#default board can be overriden by -b
set(BOARD thingy53_nrf5340_cpuapp)

find_package(Zephyr REQUIRED HINTS $ENV{ZEPHYR_BASE})

project(openthread_cli)

FILE(GLOB app_sources src/*.c)
target_sources(app PRIVATE ${app_sources})
```

## prj.conf
```kconfig
#
# Copyright (c) 2020 Nordic Semiconductor
#
# SPDX-License-Identifier: LicenseRef-Nordic-5-Clause
#

# Enable OpenThread features set
CONFIG_OPENTHREAD_NORDIC_LIBRARY_MASTER=y

# Generic networking options
CONFIG_NETWORKING=y
CONFIG_NET_L2_OPENTHREAD=y
CONFIG_NET_IPV6_NBR_CACHE=n
CONFIG_NET_IPV6_MLD=n
CONFIG_NET_SOCKETS=y
CONFIG_NET_SOCKETS_POLL_MAX=5
CONFIG_NET_SOCKETS_POSIX_NAMES=y

CONFIG_NET_CONNECTION_MANAGER=n
CONFIG_NET_IPV4=n
CONFIG_NET_IPV6=y

CONFIG_OPENTHREAD_NORDIC_LIBRARY_MTD=y
CONFIG_OPENTHREAD_MTD=y
CONFIG_OPENTHREAD_FTD=n
CONFIG_OPENTHREAD_MANUAL_START=n

# Use nrf_security
#CONFIG_OPENTHREAD_NRF_SECURITY_CHOICE=y

CONFIG_MBEDTLS_SHA1_C=n
CONFIG_FPU=y

# OpenThread joiner
CONFIG_OPENTHREAD_JOINER=y
CONFIG_OPENTHREAD_JOINER_AUTOSTART=y
CONFIG_OPENTHREAD_JOINER_PSKD="ABCDE2"
CONFIG_OPENTHREAD_SLAAC=y

# Default PRNG entropy for nRF53 Series devices is CSPRNG CC312
# which for that purpose is too slow yet
# Use Xoroshiro128+ as PRNG
CONFIG_XOROSHIRO_RANDOM_GENERATOR=y
```

## overlay-logging.conf
```kconfig
#
# Copyright (c) 2021 Nordic Semiconductor
#
# SPDX-License-Identifier: LicenseRef-Nordic-5-Clause
# Enable Zephyr logging
CONFIG_LOG=y

# Use separate thread for logging
CONFIG_LOG_MODE_DEFERRED=y

# Increase max log level to informative
CONFIG_LOG_MAX_LEVEL=3

# Option for configuring log level in this sample
CONFIG_OT_COMMAND_LINE_INTERFACE_LOG_LEVEL_INF=y

# Enable net module logging
CONFIG_NET_LOG=y
# Option for configuring log level in net config library
CONFIG_NET_CONFIG_LOG_LEVEL_INF=y
# Enable OpenThread logging
CONFIG_OPENTHREAD_DEBUG=y
# Option for configuring log level in OpenThread
CONFIG_OPENTHREAD_LOG_LEVEL_INFO=y
```

## src/main.c
```c
/*
 * Copyright (c) 2020 Nordic Semiconductor ASA
 *
 * SPDX-License-Identifier: LicenseRef-Nordic-5-Clause
 */

#include <zephyr/kernel.h>
#include <zephyr/logging/log.h>
#include <stdio.h>
#include "udp_server.h"
#include "app_ot.h"

LOG_MODULE_REGISTER(cli_sample, CONFIG_OT_COMMAND_LINE_INTERFACE_LOG_LEVEL);

#define WELLCOME_TEXT \
	"\n\r"\
	"\n\r"\
	"OpenThread main()\n\r" \
	"cli ready\n\r"

void main(void)
{
	LOG_INF(WELLCOME_TEXT);

	app_ot_init();//logs joiner info and initializes reset buttons

	int count = 0;
	while(1){
		LOG_INF("sleeping 10 sec count = %d",count);
		count++;
		k_sleep(K_MSEC(10000));
	}
}
```

## src/app_ot.h
```c
#ifndef __APP_OT_H__
#define __APP_OT_H__

#include <stdint.h>

int app_ot_init(void);

#endif /*__APP_OT_H__*/
```

## src/udp_client.c
```c
//zephyr\samples\net\sockets\echo_client\src\udp.c
#include <zephyr/kernel.h>
#include <zephyr/logging/log.h>
#include <zephyr/net/socket.h>
#include <stdio.h>

LOG_MODULE_REGISTER(udp_client, LOG_LEVEL_INF);

#define CONFIG_PEER_PORT 4242
#if !defined(CONFIG_NET_CONFIG_PEER_IPV6_ADDR)
#define CONFIG_NET_CONFIG_PEER_IPV6_ADDR "ff02::1"
#endif
#define INVALID_SOCK (-1)

bool udp_started = false;
int sock = INVALID_SOCK;

#define UDP_RX_STACK_SIZE 8192
#define UDP_RX_PRIORITY 20
#define UDP_RX_START_DELAY_MS 1000

void udp_rx_handler();

K_THREAD_DEFINE(	udp_rx_thread, UDP_RX_STACK_SIZE, udp_rx_handler, NULL, NULL, NULL,
					UDP_RX_PRIORITY, 0, UDP_RX_START_DELAY_MS);

#define RECV_BUF_SIZE 1280
static char recv_buf[RECV_BUF_SIZE];



int start_udp(void)
{
	int ret = 0;
	struct sockaddr_in6 addr6;

	LOG_INF("start_udp() CONFIG_NET_IPV6");
	addr6.sin6_family = AF_INET6;
	addr6.sin6_port = htons(CONFIG_PEER_PORT);
	inet_pton(AF_INET6, CONFIG_NET_CONFIG_PEER_IPV6_ADDR,&addr6.sin6_addr);

	sock = socket(addr6.sin6_family, SOCK_DGRAM, IPPROTO_UDP);
	if (sock < 0) {
		LOG_ERR("Failed to create UDP socket : %d", errno);
		return -errno;
	}

	/* Call connect so we can use send and recv. */
	ret = connect(sock, (struct sockaddr *)&addr6, sizeof(addr6));
	if (ret < 0) {
		LOG_ERR("Cannot connect to UDP remote : %d", errno);
		ret = -errno;
	}

	return ret;
}


int send_udp(uint8_t * data, uint8_t size)
{
	int ret;
    if(!udp_started){
        start_udp();
	    udp_started = true;
    }

	ret = send(sock, data, size, 0);

	LOG_DBG("UDP: Sent %d bytes", size);

	return ret < 0 ? -EIO : 0;

}

bool udp_rx_receive(ssize_t* received){

	*received = recv(sock, recv_buf, sizeof(recv_buf), MSG_WAITALL);

	if (*received <= 0) {
		return false;
	}
	else{
		return true;
	}
}

void udp_rx_handler(){
	ssize_t nb_rec;

	LOG_INF("hello from udp_rx_handler()");
    if(!udp_started){//could be started by higher prio thread that wants to send
        start_udp();
	    udp_started = true;
    }

	while(true){

		LOG_INF("waiting for udp recv()");
		if(udp_rx_receive(&nb_rec)){
			LOG_INF("received %d characters",nb_rec);
		}

		LOG_INF("udp rx sleeping 10 sec");
		k_sleep(K_MSEC(10000));
	}
}
```

## src/udp_server.c
```c
//zephyr\samples\net\sockets\echo_client\src\udp.c
#include <zephyr/kernel.h>
#include <zephyr/logging/log.h>
#include <zephyr/net/socket.h>
#include <errno.h>
#include <stdio.h>

LOG_MODULE_REGISTER(udp_client, LOG_LEVEL_INF);

#define CONFIG_PEER_PORT 4242
#define INVALID_SOCK (-1)

bool udp_started = false;
int sock = INVALID_SOCK;

#define UDP_RX_STACK_SIZE 8192
#define UDP_RX_PRIORITY 20
#define UDP_RX_START_DELAY_MS 1000

void udp_rx_handler();

K_THREAD_DEFINE(	udp_rx_thread, UDP_RX_STACK_SIZE, udp_rx_handler, NULL, NULL, NULL,
					UDP_RX_PRIORITY, 0, UDP_RX_START_DELAY_MS);

#define RECV_BUF_SIZE 1280
static char recv_buf[RECV_BUF_SIZE];



int start_udp(void)
{
	LOG_INF("start_udp() CONFIG_NET_IPV6");

	int ret = 0;
	struct sockaddr_in6 addr6;
	(void)memset(&addr6, 0, sizeof(addr6));
	addr6.sin6_family = AF_INET6;
	addr6.sin6_port = htons(CONFIG_PEER_PORT);

	sock = socket(addr6.sin6_family, SOCK_DGRAM, IPPROTO_UDP);
	if (sock < 0) {
		LOG_ERR("Failed to create UDP socket : %d", errno);
		return -errno;
	}

	ret = bind(sock, (struct sockaddr *)&addr6, sizeof(addr6));
	if (ret < 0) {
		NET_ERR("Failed to bind UDP socket: ret= %d ; errno = %d",ret, errno);
		ret = -errno;
	}

	return ret;
}


int send_udp(uint8_t * data, uint8_t size)
{
	int ret;
    if(!udp_started){
        start_udp();
	    udp_started = true;
    }

	ret = send(sock, data, size, 0);

	LOG_DBG("UDP: Sent %d bytes", size);

	return ret < 0 ? -EIO : 0;

}

bool udp_rx_receive(ssize_t* received){

	struct sockaddr client_addr;
	//*received = recv(sock, recv_buf, sizeof(recv_buf), MSG_WAITALL);
	socklen_t client_addr_len = sizeof(client_addr);
	*received = recvfrom(sock, recv_buf,sizeof(recv_buf), 0,&client_addr, &client_addr_len);

	//ret = sendto(data->udp.sock, data->udp.recv_buffer, received, 0,
	//			&client_addr, client_addr_len);
	//if (ret < 0) {
	//	NET_ERR("UDP: Failed to send %d", errno);
	//	ret = -errno;
	//	break;
	//}


	if (*received < 0) {
		NET_ERR("UDP: Connection error %d", errno);
		return false;
	}
	else{
		return true;
	}
}

void udp_rx_handler(){
	ssize_t nb_rec;

	LOG_INF("hello from udp_rx_handler()");
    if(!udp_started){//could be started by higher prio thread that wants to send
        start_udp();
	    udp_started = true;
    }

	while(true){

		LOG_INF("waiting for udp recv()");
		if(udp_rx_receive(&nb_rec)){
			LOG_INF("received %d characters",nb_rec);
		}

		LOG_INF("udp rx sleeping 10 sec");
		k_sleep(K_MSEC(10000));
	}
}
```
