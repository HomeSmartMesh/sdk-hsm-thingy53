## CMakeLists.txt
```
#
# Copyright (c) 2020 Nordic Semiconductor ASA
#
# SPDX-License-Identifier: LicenseRef-Nordic-5-Clause
#
cmake_minimum_required(VERSION 3.20.0)

#default board can be overriden by -b
set(BOARD thingy53_nrf5340_cpuapp)

find_package(Zephyr REQUIRED HINTS $ENV{ZEPHYR_BASE})

project(openthread_cli)

zephyr_include_directories(include)

FILE(GLOB app_sources src/*.c src/*.cpp)
target_sources(app PRIVATE ${app_sources})
```

## prj.conf
```kconfig
#
# Copyright (c) 2020 Nordic Semiconductor
#
# SPDX-License-Identifier: LicenseRef-Nordic-5-Clause
#

# Enable OpenThread features set
CONFIG_OPENTHREAD_NORDIC_LIBRARY_MASTER=y

# Generic networking options
CONFIG_NETWORKING=y
CONFIG_NET_L2_OPENTHREAD=y
CONFIG_NET_IPV6_NBR_CACHE=n
CONFIG_NET_IPV6_MLD=n
CONFIG_NET_SOCKETS=y
CONFIG_NET_SOCKETS_POLL_MAX=5
CONFIG_NET_SOCKETS_POSIX_NAMES=y

CONFIG_NET_CONNECTION_MANAGER=n
CONFIG_NET_IPV4=n
CONFIG_NET_IPV6=y
CONFIG_NET_CONFIG_NEED_IPV6=y

CONFIG_OPENTHREAD_NORDIC_LIBRARY_MTD=y
CONFIG_OPENTHREAD_MTD=y
CONFIG_OPENTHREAD_FTD=n
CONFIG_OPENTHREAD_MANUAL_START=n

# Use nrf_security
#CONFIG_OPENTHREAD_NRF_SECURITY_CHOICE=y

CONFIG_MBEDTLS_SHA1_C=n
CONFIG_FPU=y

# OpenThread joiner
CONFIG_OPENTHREAD_JOINER=y
CONFIG_OPENTHREAD_JOINER_AUTOSTART=y
CONFIG_OPENTHREAD_JOINER_PSKD="ABCDE2"
CONFIG_OPENTHREAD_SLAAC=y

# Default PRNG entropy for nRF53 Series devices is CSPRNG CC312
# which for that purpose is too slow yet
# Use Xoroshiro128+ as PRNG
CONFIG_XOROSHIRO_RANDOM_GENERATOR=y

#C++
CONFIG_CPLUSPLUS=y
CONFIG_LIB_CPLUSPLUS=y

CONFIG_EXCEPTIONS=y
CONFIG_NEWLIB_LIBC=y
CONFIG_NEWLIB_LIBC_NANO=n

#for future 3.3 
#CONFIG_CPP_EXCEPTIONS=y
#CONFIG_CPP=y
#CONFIG_LIBCPP_IMPLEMENTATION=y

CONFIG_STD_CPP11=n
CONFIG_STD_CPP17=y


#Stack
CONFIG_MAIN_STACK_SIZE=4096

#safe silence of ABI change warning as using gcc > 7 https://github.com/nlohmann/json/issues/1861
CONFIG_COMPILER_OPT="-Wno-psabi"

#print float
CONFIG_NEWLIB_LIBC_FLOAT_PRINTF=y
```

## src/main.cpp
```c
/*
 * Copyright (c) 2020 Nordic Semiconductor ASA
 *
 * SPDX-License-Identifier: LicenseRef-Nordic-5-Clause
 */

#include <zephyr/kernel.h>
#include <zephyr/logging/log.h>
#include <stdio.h>
#include "json_endpoint.h"
#include "app_ot.h"

LOG_MODULE_REGISTER(cli_sample, CONFIG_OT_COMMAND_LINE_INTERFACE_LOG_LEVEL);

#define WELLCOME_TEXT \
	"\n\r"\
	"\n\r"\
	"OpenThread main()\n\r" \
	"udp echo server\n\r"

void json_endpoint_handler(std::string &client, std::string &topic, json &request, json &response){

}

int main(void)
{
	LOG_INF(WELLCOME_TEXT);

	app_ot_init();//logs joiner info and initializes reset buttons

	set_endpoint_handler(json_endpoint_handler);

	int count = 0;
	while(1){
		LOG_INF("sleeping 10 sec count = %d",count);
		count++;
		k_sleep(K_MSEC(10000));
	}
}
```

## src/app_ot.c
```c
#include <zephyr/kernel.h>
#include <zephyr/logging/log.h>
#include <zephyr/drivers/uart.h>
#include <zephyr/sys/printk.h>
#include <zephyr/sys/reboot.h>
#include <stdio.h>
#include <openthread/thread.h>
#include <openthread/link.h>
#include <openthread/instance.h>

#include "app_button.h"
#include "app_ot.h"

LOG_MODULE_REGISTER(ot_app, CONFIG_OT_COMMAND_LINE_INTERFACE_LOG_LEVEL);

otInstance* instance;
#if defined(CONFIG_OPENTHREAD_JOINER_PSKD)
#define OT_JOINER_PSKD CONFIG_OPENTHREAD_JOINER_PSKD
#else
#define OT_JOINER_PSKD ""
#endif

void click(void){
	printk("button - click - rebooting warm\n");
	sys_reboot(SYS_REBOOT_WARM);
}

void long_press(){
	printk("button - long press - OpenThread Factory Reset\n");
	otInstanceFactoryReset(instance);
	sys_reboot(SYS_REBOOT_COLD);
}

void get_eui64(char* eui64){
	otExtAddress aEui64;
	otLinkGetFactoryAssignedIeeeEui64(instance,&aEui64);
	for(int i=0;i<8;i++){
		sprintf(eui64+=2,"%02X",aEui64.m8[i]);
	}
	eui64[16] = '\0';
}

int app_ot_init(void){
	instance = otInstanceInitSingle();

	app_button_init();
	app_button_set_short_callback(click);
	app_button_set_long_callback(long_press);
	app_button_set_short_timeout(1000);
	app_button_set_long_timeout(4000);

	char eui64[17];
	get_eui64(eui64);
	LOG_INF("Joiner eui64: %s ; pskd: %s\n",eui64,OT_JOINER_PSKD);
	LOG_INF("qrcode: v=1&&eui=%s&&cc=%s\n",eui64,OT_JOINER_PSKD);
	LOG_INF("https://dhrishi.github.io/connectedhomeip/qrcode.html?data=v%%3D1%%26%%26eui%%3D%s%%26%%26cc%%3D%s\n",eui64,OT_JOINER_PSKD);

	return 0;
}
```

## src/json_endpoint.cpp
```c
//zephyr\samples\net\sockets\echo_client\src\udp.c
#include <zephyr/kernel.h>
#include <zephyr/logging/log.h>
#include <zephyr/net/socket.h>
#include <errno.h>
#include <stdio.h>

#include <string>

#include "json_endpoint.h"

LOG_MODULE_REGISTER(udp_client, LOG_LEVEL_INF);

#define CONFIG_PEER_PORT 4242
#define INVALID_SOCK (-1)

bool udp_started = false;
int sock = INVALID_SOCK;

#define UDP_RX_STACK_SIZE 8192
#define UDP_RX_PRIORITY 20
#define UDP_RX_START_DELAY_MS 1000

void udp_rx_handler();

K_THREAD_DEFINE(	udp_rx_thread, UDP_RX_STACK_SIZE, udp_rx_handler, NULL, NULL, NULL,
					UDP_RX_PRIORITY, 0, UDP_RX_START_DELAY_MS);

#define RECV_BUF_SIZE 1280
static char recv_buf[RECV_BUF_SIZE];

static json_endpoint_handler_t m_json_endpoint_handler = NULL;
json request;
json response;


int start_udp(void)
{
	LOG_INF("start_udp() CONFIG_NET_IPV6");

	int ret = 0;
	struct sockaddr_in6 addr6;
	(void)memset(&addr6, 0, sizeof(addr6));
	addr6.sin6_family = AF_INET6;
	addr6.sin6_port = htons(CONFIG_PEER_PORT);

	sock = socket(addr6.sin6_family, SOCK_DGRAM, IPPROTO_UDP);
	if (sock < 0) {
		LOG_ERR("Failed to create UDP socket : %d", errno);
		return -errno;
	}

	ret = bind(sock, (struct sockaddr *)&addr6, sizeof(addr6));
	if (ret < 0) {
		NET_ERR("Failed to bind UDP socket: ret= %d ; errno = %d",ret, errno);
		ret = -errno;
	}

	return ret;
}


int send_udp(uint8_t * data, uint8_t size)
{
	int ret;
    if(!udp_started){
        start_udp();
	    udp_started = true;
    }

	ret = send(sock, data, size, 0);

	LOG_DBG("UDP: Sent %d bytes", size);

	return ret < 0 ? -EIO : 0;

}

void udp_rx_handler(){

	LOG_INF("hello from udp_rx_handler()");
    if(!udp_started){//could be started by higher prio thread that wants to send
        start_udp();
	    udp_started = true;
    }

	while(true){
		LOG_INF("waiting for udp recv()");
		struct sockaddr client_addr;
		socklen_t client_addr_len = sizeof(client_addr);
		ssize_t received = recvfrom(sock, recv_buf,sizeof(recv_buf), 0,&client_addr, &client_addr_len);
		if (received < 0) {
			NET_ERR("UDP: Connection error %d", errno);
		}else{
			recv_buf[received] = '\0';
			LOG_INF("received %d characters: %s\n",received,recv_buf);
		}

		if(m_json_endpoint_handler != NULL){
			std::string payload(recv_buf,received);
			std::string client = "client";
			std::string topic = "topic";
			m_json_endpoint_handler(client, topic, request, response);

			ssize_t ret = sendto(sock, recv_buf, received, 0, &client_addr, client_addr_len);
			if (ret < 0) {
				NET_ERR("UDP: Failed to send %d", errno);
				ret = -errno;
			}
		}


	}
}

void set_endpoint_handler(json_endpoint_handler_t handler)
{
	m_json_endpoint_handler = handler;
}
```

## src/udp_server.h
```c
#ifndef __UDP_SERVER_H__
#define __UDP_SERVER_H__

#include <stdint.h>

#ifdef __cplusplus
extern "C" {
#endif


#ifdef __cplusplus
}
#endif

#endif /*__UDP_SERVER_H__*/
```
