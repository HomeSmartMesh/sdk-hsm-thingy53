## prj.conf
```kconfig
#
# Copyright (c) 2020 Nordic Semiconductor
#
# SPDX-License-Identifier: LicenseRef-Nordic-5-Clause
#

# Enable OpenThread features set
CONFIG_OPENTHREAD_NORDIC_LIBRARY_MASTER=y

# Generic networking options
CONFIG_NETWORKING=y
CONFIG_NET_L2_OPENTHREAD=y
CONFIG_NET_IPV6_NBR_CACHE=n
CONFIG_NET_IPV6_MLD=n
CONFIG_NET_SOCKETS=y
CONFIG_NET_SOCKETS_POLL_MAX=5
CONFIG_NET_SOCKETS_POSIX_NAMES=y

CONFIG_NET_CONNECTION_MANAGER=n
CONFIG_NET_IPV4=n
CONFIG_NET_IPV6=y
CONFIG_NET_CONFIG_NEED_IPV6=y

CONFIG_OPENTHREAD_NORDIC_LIBRARY_MTD=y
CONFIG_OPENTHREAD_MTD=y
CONFIG_OPENTHREAD_FTD=n
CONFIG_OPENTHREAD_MANUAL_START=n

# Use nrf_security
#CONFIG_OPENTHREAD_NRF_SECURITY_CHOICE=y

CONFIG_MBEDTLS_SHA1_C=n
CONFIG_FPU=y

# OpenThread joiner
CONFIG_OPENTHREAD_JOINER=y
CONFIG_OPENTHREAD_JOINER_AUTOSTART=y
CONFIG_OPENTHREAD_JOINER_PSKD="ABCDE2"
CONFIG_OPENTHREAD_SLAAC=y

# Default PRNG entropy for nRF53 Series devices is CSPRNG CC312
# which for that purpose is too slow yet
# Use Xoroshiro128+ as PRNG
CONFIG_XOROSHIRO_RANDOM_GENERATOR=y
```

## src/app_button.h
```c
#ifndef __APP_BUTTON_H__
#define __APP_BUTTON_H__

#include <stdint.h>

int app_button_init(void);

typedef void (*button_callback_handler_t)(void);

void app_button_set_short_callback(button_callback_handler_t cb);
void app_button_set_long_callback(button_callback_handler_t cb);
void app_button_set_short_timeout(int64_t timeout_ms);
void app_button_set_long_timeout(int64_t timeout_ms);

#endif /*__APP_BUTTON_H__*/
```

## src/udp_server.c
```c
//zephyr\samples\net\sockets\echo_client\src\udp.c
#include <zephyr/kernel.h>
#include <zephyr/logging/log.h>
#include <zephyr/net/socket.h>
#include <errno.h>
#include <stdio.h>

LOG_MODULE_REGISTER(udp_client, LOG_LEVEL_INF);

#define CONFIG_PEER_PORT 4242
#define INVALID_SOCK (-1)

bool udp_started = false;
int sock = INVALID_SOCK;

#define UDP_RX_STACK_SIZE 8192
#define UDP_RX_PRIORITY 20
#define UDP_RX_START_DELAY_MS 1000

void udp_rx_handler();

K_THREAD_DEFINE(	udp_rx_thread, UDP_RX_STACK_SIZE, udp_rx_handler, NULL, NULL, NULL,
					UDP_RX_PRIORITY, 0, UDP_RX_START_DELAY_MS);

#define RECV_BUF_SIZE 1280
static char recv_buf[RECV_BUF_SIZE];



int start_udp(void)
{
	LOG_INF("start_udp() CONFIG_NET_IPV6");

	int ret = 0;
	struct sockaddr_in6 addr6;
	(void)memset(&addr6, 0, sizeof(addr6));
	addr6.sin6_family = AF_INET6;
	addr6.sin6_port = htons(CONFIG_PEER_PORT);

	sock = socket(addr6.sin6_family, SOCK_DGRAM, IPPROTO_UDP);
	if (sock < 0) {
		LOG_ERR("Failed to create UDP socket : %d", errno);
		return -errno;
	}

	ret = bind(sock, (struct sockaddr *)&addr6, sizeof(addr6));
	if (ret < 0) {
		NET_ERR("Failed to bind UDP socket: ret= %d ; errno = %d",ret, errno);
		ret = -errno;
	}

	return ret;
}


int send_udp(uint8_t * data, uint8_t size)
{
	int ret;
    if(!udp_started){
        start_udp();
	    udp_started = true;
    }

	ret = send(sock, data, size, 0);

	LOG_DBG("UDP: Sent %d bytes", size);

	return ret < 0 ? -EIO : 0;

}

void udp_rx_handler(){

	LOG_INF("hello from udp_rx_handler()");
    if(!udp_started){//could be started by higher prio thread that wants to send
        start_udp();
	    udp_started = true;
    }

	while(true){
		LOG_INF("waiting for udp recv()");
		struct sockaddr client_addr;
		socklen_t client_addr_len = sizeof(client_addr);
		ssize_t received = recvfrom(sock, recv_buf,sizeof(recv_buf), 0,&client_addr, &client_addr_len);
		if (received < 0) {
			NET_ERR("UDP: Connection error %d", errno);
		}else{
			recv_buf[received] = '\0';
			LOG_INF("received %d characters: %s\n",received,recv_buf);
		}

		ssize_t ret = sendto(sock, recv_buf, received, 0, &client_addr, client_addr_len);
		if (ret < 0) {
			NET_ERR("UDP: Failed to send %d", errno);
			ret = -errno;
		}

	}
}
```

## src/udp_server.h
```c
#ifndef __UDP_SERVER_H__
#define __UDP_SERVER_H__

#include <stdint.h>

#endif /*__UDP_SERVER_H__*/
```
