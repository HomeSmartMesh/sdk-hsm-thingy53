## CMakeLists.txt
```
#
# Copyright (c) 2018 Bosch Sensortec GmbH
#
# SPDX-License-Identifier: Apache-2.0
#

cmake_minimum_required(VERSION 3.20.0)
#default board can be overriden by -b
set(BOARD thingy53_nrf5340_cpuapp)
set(DTC_OVERLAY_FILE app.overlay)

find_package(Zephyr REQUIRED HINTS $ENV{ZEPHYR_BASE})
project(bme680_server)

target_sources(app PRIVATE src/main.cpp)
```

## prj.conf
```kconfig
CONFIG_STDOUT_CONSOLE=y
CONFIG_I2C=y
CONFIG_BME688=y
CONFIG_BME688_SERVER=y
CONFIG_SENSOR=y

CONFIG_FPU=y

#C++
CONFIG_CPLUSPLUS=y
CONFIG_LIB_CPLUSPLUS=y

CONFIG_EXCEPTIONS=y
CONFIG_NEWLIB_LIBC=y
CONFIG_NEWLIB_LIBC_NANO=n

#for future 3.3 
#CONFIG_CPP_EXCEPTIONS=y
#CONFIG_CPP=y
#CONFIG_LIBCPP_IMPLEMENTATION=y

CONFIG_STD_CPP11=n
CONFIG_STD_CPP17=y


#Stack
CONFIG_MAIN_STACK_SIZE=4096

#safe silence of ABI change warning as using gcc > 7 https://github.com/nlohmann/json/issues/1861
CONFIG_COMPILER_OPT="-Wno-psabi"

#print float
CONFIG_NEWLIB_LIBC_FLOAT_PRINTF=y
```

## src/main.cpp
```c
/*
 * Copyright (c) 2018 Bosch Sensortec GmbH
 *
 * SPDX-License-Identifier: Apache-2.0
 */

#include <zephyr/kernel.h>
#include <stdio.h>
#include "bme688_server.h"
#include <string>

json config =  R"(
  {
    "temperatures": [320, 100, 100, 100, 200, 200, 200, 320, 320, 320],
    "durations": [100, 100, 100, 100, 100, 100, 100, 100, 100, 100]
  }
)"_json;

std::string text;

void bme688_handler(json &data){
	text = data.dump(4);
	printf(" - bme688_handler> %s\n",text.c_str());
}

int main(void)
{
	printf(" - Test bme688 server app - early debug wait connection\n");
	k_sleep(K_MSEC(10000));
	printf(" - Test bme688 server app - start\n");
	printf(" - setting heater config: ");
	text = config.dump(4);
	printf("%s\n",text.c_str());

	set_bme688_config(config);
	start_bme688(bme688_handler);
	k_sleep(K_MSEC(3000));

	uint32_t count = 0;
	while (1) {
		printf(" - loop %d main sleeping 30 sec\n",count++);
		k_sleep(K_MSEC(30000));
	}
	return 0;
}
```
