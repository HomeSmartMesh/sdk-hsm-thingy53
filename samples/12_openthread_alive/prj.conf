## CMakeLists.txt
```
#
# Copyright (c) 2020 Nordic Semiconductor ASA
#
# SPDX-License-Identifier: LicenseRef-Nordic-5-Clause
#
cmake_minimum_required(VERSION 3.20.0)

#default board can be overriden by -b
set(BOARD thingy53_nrf5340_cpuapp)

find_package(Zephyr REQUIRED HINTS $ENV{ZEPHYR_BASE})

project(openthread_cli)

# NORDIC SDK APP START
target_sources(app PRIVATE src/main.c src/udp_client.c src/app_button.c)
# NORDIC SDK APP END
```

## prj.conf
```kconfig
#
# Copyright (c) 2020 Nordic Semiconductor
#
# SPDX-License-Identifier: LicenseRef-Nordic-5-Clause
#

# Enable OpenThread features set
CONFIG_OPENTHREAD_NORDIC_LIBRARY_MASTER=y

# Generic networking options
CONFIG_NETWORKING=y
CONFIG_NET_L2_OPENTHREAD=y
CONFIG_NET_IPV6_NBR_CACHE=n
CONFIG_NET_IPV6_MLD=n
CONFIG_NET_SOCKETS=y
CONFIG_NET_SOCKETS_POLL_MAX=5
CONFIG_NET_SOCKETS_POSIX_NAMES=y

CONFIG_NET_CONNECTION_MANAGER=n
CONFIG_NET_IPV4=n
CONFIG_NET_IPV6=y

CONFIG_OPENTHREAD_NORDIC_LIBRARY_MTD=y
CONFIG_OPENTHREAD_MTD=y
CONFIG_OPENTHREAD_FTD=n
CONFIG_OPENTHREAD_MANUAL_START=n

# Use nrf_security
#CONFIG_OPENTHREAD_NRF_SECURITY_CHOICE=y

CONFIG_MBEDTLS_SHA1_C=n
CONFIG_FPU=y

# OpenThread joiner
CONFIG_OPENTHREAD_JOINER=y
CONFIG_OPENTHREAD_JOINER_AUTOSTART=y
CONFIG_OPENTHREAD_JOINER_PSKD="ABCDE2"
CONFIG_OPENTHREAD_SLAAC=y
```

## src/main.c
```c
/*
 * Copyright (c) 2020 Nordic Semiconductor ASA
 *
 * SPDX-License-Identifier: LicenseRef-Nordic-5-Clause
 */

#include <zephyr/kernel.h>
#include <zephyr/logging/log.h>

#include <zephyr/drivers/uart.h>
#include <stdio.h>
#include <zephyr/sys/reboot.h>
#include <openthread/thread.h>
#include <openthread/instance.h>
#include "udp_client.h"
#include "app_button.h"

otInstance* instance;

LOG_MODULE_REGISTER(cli_sample, CONFIG_OT_COMMAND_LINE_INTERFACE_LOG_LEVEL);

#define WELLCOME_TEXT \
	"\n\r"\
	"\n\r"\
	"OpenThread main()\n\r" \
	"cli ready\n\r"

void click(void){
	printk("button - click - rebooting warm\n");
	sys_reboot(SYS_REBOOT_WARM);
}

void long_press(){
	printk("button - long press - OpenThread Factory Reset\n");
	otInstanceFactoryReset(instance);
	sys_reboot(SYS_REBOOT_COLD);
}

void main(void)
{
	instance = otInstanceInitSingle();
	LOG_INF(WELLCOME_TEXT);

	app_button_init();
	app_button_set_short_callback(click);
	app_button_set_long_callback(long_press);
	app_button_set_short_timeout(1000);
	app_button_set_long_timeout(4000);

	int count = 0;
	while(1){
		char message[250];
		int size = sprintf(message,"thread_thingy_53/{\"alive\":%d}",count);
		send_udp(message, size);
		count++;

		LOG_INF("sleeping 10 sec");
		k_sleep(K_MSEC(10000));
	}
}
```

## src/app_button.c
```c
#include <zephyr/kernel.h>
#include <zephyr/device.h>
#include <zephyr/drivers/gpio.h>
#include <zephyr/sys/util.h>
#include <zephyr/sys/printk.h>
#include <inttypes.h>
#include <zephyr/logging/log.h>
#include "app_button.h"

LOG_MODULE_REGISTER(cli_button, CONFIG_OT_COMMAND_LINE_INTERFACE_LOG_LEVEL);

#define SW0_NODE	DT_ALIAS(sw0)
#if !DT_NODE_HAS_STATUS(SW0_NODE, okay)
#error "Unsupported board: sw0 devicetree alias is not defined"
#endif
static const struct gpio_dt_spec button = GPIO_DT_SPEC_GET_OR(SW0_NODE, gpios,{0});
static struct gpio_callback button_cb_data;
static struct k_work_delayable long_press_work;

#define LONG_PRESS_TIMEOUT K_SECONDS(4)
#define SHORT_PRESS_TIMEOUT_MSEC 1000
#define LONG_PRESS_TIMEOUT_MSEC 4000

static button_callback_handler_t button_short_press = NULL;
static button_callback_handler_t button_long_press = NULL;
int64_t short_press_timeout_ms = SHORT_PRESS_TIMEOUT_MSEC;
int64_t long_press_timeout_ms = LONG_PRESS_TIMEOUT_MSEC;


static bool pressed;
static bool booting;
static bool triggered;
int64_t press_time;

static void button_hold_timeout(struct k_work *work)
{
	triggered = true;//used to cancel
	LOG_INF("Button hold timeout\n");
	if(button_long_press){
		button_long_press();
	}
}

static bool button_is_pressed(void)
{
	return gpio_pin_get_dt(&button) > 0;
}

void button_interrupt(const struct device *dev, struct gpio_callback *cb, uint32_t pins)
{
	//this debounces cases of very fast signal jitter that loses the release state
	//while executing the press call
	if (button_is_pressed() == pressed) {
		return;
	}
	pressed = !pressed;
	if (pressed) {
		press_time = k_uptime_get();
		triggered = false;
		k_work_reschedule(&long_press_work, LONG_PRESS_TIMEOUT);
		LOG_INF("Button pressed at %" PRIi64 "\n", press_time);
	}
	else{//released
		if(booting){
			LOG_INF("Button released after boot\n");
			booting = false;
		}
		else{
			if(!triggered){//that's because it was released too early - cancel hold timeout
				int64_t time = k_uptime_delta(&press_time);
				if(time < short_press_timeout_ms){
					if(button_short_press){
						button_short_press();
					}
				}else{
					LOG_INF("Button released after %" PRIi64 " ms - not short, not long\n", time);
				}
				k_work_cancel_delayable(&long_press_work);
			}//else triggered, nothing to do, release after trigger
		}
	}
}

int app_button_init(void){
	int ret;

	if (!device_is_ready(button.port)) {
		LOG_ERR("Error: button device %s is not ready\n",button.port->name);
		return ENODEV;
	}

	ret = gpio_pin_configure_dt(&button, GPIO_INPUT);
	if (ret != 0) {
		LOG_ERR("Error %d: failed to configure %s pin %d\n",ret, button.port->name, button.pin);
		return ret;
	}

	ret = gpio_pin_interrupt_configure_dt(&button,GPIO_INT_EDGE_BOTH);
	if (ret != 0) {
		LOG_ERR("Error %d: failed to configure interrupt on %s pin %d\n",ret, button.port->name, button.pin);
		return ret;
	}

	booting = true;
	pressed = button_is_pressed();
	triggered = false;
	press_time = k_uptime_get();//in case of boot with btn pressed
	k_work_init_delayable(&long_press_work, button_hold_timeout);

	gpio_init_callback(&button_cb_data, button_interrupt, BIT(button.pin));
	gpio_add_callback(button.port, &button_cb_data);
	LOG_INF("Set up button at %s pin %d\n", button.port->name, button.pin);

	return ret;
}

void app_button_set_short_callback(button_callback_handler_t cb){
	button_short_press = cb;
}

void app_button_set_long_callback(button_callback_handler_t cb){
	button_long_press = cb;
}

void app_button_set_long_timeout(int64_t timeout_ms){
	long_press_timeout_ms = timeout_ms;
}

void app_button_set_short_timeout(int64_t timeout_ms){
	short_press_timeout_ms = timeout_ms;
}
```
